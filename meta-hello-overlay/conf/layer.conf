## meta-hello-overlay/conf/layer.conf
```bitbake
# meta-hello-overlay layer configuration

BBPATH .= ":${LAYERDIR}"

BBFILES += "${LAYERDIR}/recipes-*/*/*.bb \
            ${LAYERDIR}/recipes-*/*/*.bbappend"

BBFILE_COLLECTIONS += "meta-hello-overlay"
BBFILE_PATTERN_meta-hello-overlay = "^${LAYERDIR}/"
BBFILE_PRIORITY_meta-hello-overlay = "6"

# REQUIRED: compatible with Yocto 4.0
LAYERSERIES_COMPAT_meta-hello-overlay = "kirkstone"
```
